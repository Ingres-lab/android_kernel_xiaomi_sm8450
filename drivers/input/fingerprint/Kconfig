## drivers/input/fingerprint/Kconfig
```kconfig
#
# Fingerprint driver configuration
#

menuconfig INPUT_FINGERPRINT
	bool "Fingerprints"
	help
	  Say Y here to enable fingerprint drivers.

if INPUT_FINGERPRINT

source "drivers/input/fingerprint/fpc_1540/Kconfig"
source "drivers/input/fingerprint/goodix_tee/Kconfig"

endif

source "drivers/input/fingerprint/xiaomi_fp/Kconfig"
```
