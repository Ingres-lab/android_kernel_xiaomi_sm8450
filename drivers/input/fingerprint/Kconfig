## drivers/input/fingerprint/Kconfig
```kconfig
#
# Fingerprint driver configuration
#

menuconfig INPUT_FINGERPRINT
	bool "Fingerprints"
	help
	  Say Y here to enable fingerprint drivers.

if INPUT_FINGERPRINT

source "$(KCONFIG_EXT_PREFIX)drivers/input/fingerprint/fpc_1540/Kconfig"
source "$(KCONFIG_EXT_PREFIX)drivers/input/fingerprint/goodix_tee/Kconfig"

endif

source "$(KCONFIG_EXT_PREFIX)drivers/input/fingerprint/xiaomi_fp/Kconfig"
```

## drivers/input/touchscreen/Kconfig
```kconfig
# SPDX-License-Identifier: GPL-2.0-only
#
# Input misc drivers configuration
#

config TOUCHSCREEN_CAP1296
        tristate "touch driver for cap1296"
        help
          The CAP1296 is a multiple channel capacitive touch
          sensor controller. It contains six (6) individual capaci-
          tive touch sensor inputs with programmable sensitivity
          for use in touch sensor applications.


# Xiaomi touch feature framework and ST FTS v5.2.1 SPI touch (ingres)
source "$(KCONFIG_EXT_PREFIX)drivers/input/touchscreen/xiaomi/Kconfig"
source "$(KCONFIG_EXT_PREFIX)drivers/input/touchscreen/fts_spi/Kconfig"
```

## drivers/media/rc/Kconfig
```kconfig
# SPDX-License-Identifier: GPL-2.0-only

config IR_SPI_XIAOMI
	tristate "SPI connected IR LED, Xiaomi buffer size"
	depends on SPI && LIRC && OF
	help
	  The upstream ir-spi driver (IR blaster LED on SPI) built as a vendor
	  module with a 32 KiB transmit buffer: the 4 KiB upstream limit is too
	  small for the IR codes Xiaomi's remote app sends. GKI does not build
	  ir-spi, so ingres ships this copy instead.
```

## drivers/power/supply/Kconfig
```kconfig
# SPDX-License-Identifier: GPL-2.0-only
if POWER_SUPPLY

config QTI_BATTERY_CHARGER
	tristate "QTI Glink battery charger"
	depends on QTI_PMIC_GLINK && EXTCON && TYPEC
	help
	  Say Y here to enable Qualcomm Technologies, Inc. battery charger
	  driver which interfaces with the charger firmware running on the
	  remote subsystem (e.g. DSP) by communicating over PMIC Glink channel
	  and provides information about the battery, USB and wireless charging
	  by exposing them as power supply devices.

	  To compile the driver as a module, choose M here: the module will be
	  called qti_battery_charger.

config CHARGER_QCOM_SMBB
	tristate "Qualcomm Switch-Mode Battery Charger and Boost"
	depends on MFD_SPMI_PMIC || COMPILE_TEST
	depends on OF
	depends on EXTCON
	depends on REGULATOR
	help
	  Say Y to include support for the Switch-Mode Battery Charger and
	  Boost (SMBB) hardware found in Qualcomm PM8941 PMICs.  The charger
	  is an integrated, single-cell lithium-ion battery charger.  DT
	  configuration is required for loading, see the devicetree
	  documentation for more detail.  The base name for this driver is
	  'pm8941_charger'.

config BATTERY_MAX1720X
	tristate "Maxim MAX17201/MAX17215 Fuel Gauge"
	depends on I2C
	select REGMAP_I2C
	help
	  MAX1720x is fuel-gauge systems for lithium-ion (Li+) batteries
	  in handheld and portable equipment.

	  Say Y here to enable support for the MAX17201/MAX17335 standalone
	  battery gas-gauge.

config QTI_CHARGER_NFC_VREG
	bool "Allow client to vote on Charger reverse boost regulator"
	depends on QTI_BATTERY_CHARGER
	help
	  Say 'y' here to allow client drivers to enable and perform voltage
	  get/set operations via the regulator framework on the charger reverse
	  boost regulator. This may be used by client drivers such as NFC
	  to manage their power supply requirements through the charger’s
	  reverse boost regulator.

source "$(KCONFIG_EXT_PREFIX)drivers/power/supply/qcom/Kconfig"

endif # POWER_SUPPLY

# Xiaomi charger options (ingres: BQ_FG_2S, BQ_FUEL_GAUGE, MI_CHARGER_M81, MI_WIRELESS)
config BQ_FG_2S
	tristate "2s battery fuel gauge support"
	help
	  Say Y here to have support for 2s battery fuel gauge.

config MI_WIRELESS
	tristate "mi wirless config"
	help
	  Say Y here to enable mi wireless

config WIRELESS_REVERSE_CLOSE
        tristate "mi wirless reverse close config"
        depends on MI_WIRELESS
        help
          Say Y here to disable mi wireless reverse function

config MI_PEN_WIRELESS
	tristate "mi pen wirless config"
	help
	  Say Y here to enable mi wireless

config BQ_FUEL_GAUGE
	tristate "BQ fuel gauge config"
	help
	  Say y here to enable Bq fuel gauge

config BQ_CLOUD_AUTHENTICATION
	tristate "BQ cloud thentication config"
	help
	  Say Y here to enable Bq cloud thentication

config DUAL_FUEL_GAUGE
	tristate "BQ fuel gauge config"
	help
	  Say y here to enable Bq fuel gauge

config BQ_FG_UPDATE
	tristate "BQ fuel gauge config"
	help
	  Say y here to enable Bq fuel gauge

config MI_ENABLE_DP
	tristate "enable or disable displayPort config"
	help
	  Say Y here to enable create node to support dp function

config REVERSE_33W
	tristate "enable or disable reverse 33W config"
	help
	  Say Y here to enable create node to support reverse_33W of downshift function

config MI_DTPT
	tristate "mi dtpt config"
        help
          Say Y here to enable mi dtpt

config ANTI_BURN_DETECT
	tristate "anti burn detect config"
	help
	  Say Y or M here to enable anti burn detect config

config MI_WLS_REVERSE_CHG_ONLY
	tristate "mi only reverse wls chg config"
        help
          Say Y here to enable mi only reverse wls chg

config MI_CHARGER_M81
	tristate "match m81 charger properties"
	help
	  Say Y here to enable xiaomi properties similar to
	  qti_battery_charger_main_m81 module on stock

config MI_FG_MAX_LIFE
	bool "battery max life statistics properties"
	help
	  Say Y here on targets whose charger firmware implements the
	  max_life_vol, max_life_temp and over_vol_duration properties,
	  such as marble and zeus.

	  These sit in the middle of enum xm_property_id, whose indices are
	  the opcodes exchanged with the charger firmware, so enabling them
	  on a target that lacks them shifts every later property and makes
	  the fg1_* nodes report the wrong values. If unsure, say N.
```
